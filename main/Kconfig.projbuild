## main/Kconfig.projbuild
```kconfig
menu "Macropad"

config MACROPAD_MANUFACTURER_NAME
    string "ZCL Basic: Manufacturer Name"
    default "4DERT"
    help
      ZCL Basic attribute (string). Leave empty to skip setting.

config MACROPAD_MODEL_IDENTIFIER
    string "ZCL Basic: Model Identifier"
    default "Macropad"
    help
      ZCL Basic attribute (string). Leave empty to skip setting.

choice MACROPAD_LED_DRIVER
    prompt "Macropad LED Driver"
    default MACROPAD_LED_DRIVER_GPIO
    help
        Select the type of LED driver to compile.

    config MACROPAD_LED_DRIVER_WS2812
        bool "Addressable LEDs (WS2812)"
        help
            Use the WS2812 addressable LEDs.

    config MACROPAD_LED_DRIVER_GPIO
        bool "Simple GPIO LED"
        help
            Use a single GPIO for basic on/off. Effects will be disabled.

endchoice

config MACROPAD_ADDRESSABLE_LED_GPIO
    int "Addressable LEDs GPIO Pin"
    depends on MACROPAD_LED_DRIVER_WS2812
    default 17
    help
      GPIO for WS2812 LEDs.

config MACROPAD_LED_NUM
    int "Number of addressable LEDs"
    depends on MACROPAD_LED_DRIVER_WS2812
    default 10
    range 1 255
    help
      Number of addressable LEDs available on the macropad LED strip.

config MACROPAD_LED_GPIO 
    int "LED GPIO Pin"
    depends on MACROPAD_LED_DRIVER_GPIO
    default 15 
    help 
        GPIO for the simple status LED.

config MACROPAD_KEYS_NUM
    int "Number of keys"
    range 1 6
    default 6

# Per-key GPIO and endpoint
if MACROPAD_KEYS_NUM >= 1
config MACROPAD_KEY0_GPIO
    int "Key0 GPIO"
    default 21
config MACROPAD_KEY0_EP
    int "Key0 Zigbee Endpoint"
    default 1
endif

if MACROPAD_KEYS_NUM >= 2
config MACROPAD_KEY1_GPIO
    int "Key1 GPIO"
    default 22
config MACROPAD_KEY1_EP
    int "Key1 Zigbee Endpoint"
    default 2
endif

if MACROPAD_KEYS_NUM >= 3
config MACROPAD_KEY2_GPIO
    int "Key2 GPIO"
    default 20
config MACROPAD_KEY2_EP
    int "Key2 Zigbee Endpoint"
    default 3
endif

if MACROPAD_KEYS_NUM >= 4
config MACROPAD_KEY3_GPIO
    int "Key3 GPIO"
    default 7
config MACROPAD_KEY3_EP
    int "Key3 Zigbee Endpoint"
    default 4
endif

if MACROPAD_KEYS_NUM >= 5
config MACROPAD_KEY4_GPIO
    int "Key4 GPIO"
    default 19
config MACROPAD_KEY4_EP
    int "Key4 Zigbee Endpoint"
    default 5
endif

if MACROPAD_KEYS_NUM >= 6
config MACROPAD_KEY5_GPIO
    int "Key5 GPIO"
    default 6
config MACROPAD_KEY5_EP
    int "Key5 Zigbee Endpoint"
    default 6
endif

endmenu
```
